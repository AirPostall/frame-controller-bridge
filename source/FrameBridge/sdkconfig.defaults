## source/FrameBridge/sdkconfig.defaults
```kconfig
CONFIG_IDF_TARGET="esp32s3"
CONFIG_APP_REPRODUCIBLE_BUILD=y
CONFIG_BT_ENABLED=y
CONFIG_BT_NIMBLE_ENABLED=y
CONFIG_BT_NIMBLE_MAX_CONNECTIONS=3
CONFIG_BT_CTRL_BLE_MAX_ACT=6
CONFIG_BT_NIMBLE_ROLE_CENTRAL=y
CONFIG_BT_NIMBLE_ROLE_OBSERVER=y
CONFIG_BT_NIMBLE_ROLE_PERIPHERAL=y
CONFIG_BT_NIMBLE_ROLE_BROADCASTER=y
CONFIG_BT_NIMBLE_GATT_CLIENT=y
CONFIG_BT_NIMBLE_GATT_SERVER=y
CONFIG_BT_NIMBLE_SECURITY_ENABLE=y
CONFIG_BT_NIMBLE_SM_SC=y
CONFIG_BT_NIMBLE_HS_PVCY=y
CONFIG_BT_NIMBLE_NVS_PERSIST=y
CONFIG_BT_NIMBLE_MAX_CCCDS=12
# CONFIG_BT_NIMBLE_EXT_ADV is not set
CONFIG_TINYUSB_HID_COUNT=1
CONFIG_TINYUSB_SUSPEND_CALLBACK=y
CONFIG_TINYUSB_RESUME_CALLBACK=y
CONFIG_ESP_CONSOLE_SECONDARY_NONE=y
CONFIG_ESP_COEX_SW_COEXIST_ENABLE=y
CONFIG_FREERTOS_HZ=1000
CONFIG_PARTITION_TABLE_CUSTOM=y
CONFIG_PARTITION_TABLE_CUSTOM_FILENAME="partitions.csv"
```

## source/main/Kconfig.projbuild
```kconfig
menu "Steam Frame controllers"

config FRAME_LEFT_ADDRESS
    string "Left controller Bluetooth address"
    default "00:00:00:00:00:00"
    help
        Leave this at zero for an unpaired controller.

config FRAME_RIGHT_ADDRESS
    string "Right controller Bluetooth address"
    default "00:00:00:00:00:00"
    help
        Leave this at zero for an unpaired controller.

config FRAME_LOG_INTERVAL_MS
    int "Minimum milliseconds between notification samples per controller"
    range 0 60000
    default 250
    help
        Each sample includes the running packet count and up to 64 bytes.
        Set to zero to print every packet that reaches the callback. At high
        report rates the serial console can become the bottleneck.

endmenu
```
